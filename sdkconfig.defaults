## sdkconfig.defaults
```kconfig
# sdkconfig defaults — seeds the initial sdkconfig.
# This file maps each setting back to either an arduino-cli FQBN value
# or a tuning we couldn't reach from arduino-cli. Edit via
# `idf.py menuconfig` after `idf.py reconfigure` and save back here if
# the change should be permanent.
#
# Only edits to sdkconfig.defaults that aren't already in sdkconfig take
# effect on reconfigure. To re-seed completely: `rm sdkconfig`.

# --- Target + flash (FQBN: esp32:esp32:esp32s3, FlashSize=16M) ---
CONFIG_IDF_TARGET="esp32s3"
CONFIG_ESPTOOLPY_FLASHSIZE_16MB=y
CONFIG_ESPTOOLPY_FLASHSIZE="16MB"
CONFIG_ESPTOOLPY_FLASHMODE_QIO=y
CONFIG_ESPTOOLPY_FLASHFREQ_80M=y

# --- Partition table — carry over from arduino-cli build ---
CONFIG_PARTITION_TABLE_CUSTOM=y
CONFIG_PARTITION_TABLE_CUSTOM_FILENAME="partitions.csv"
CONFIG_PARTITION_TABLE_FILENAME="partitions.csv"

# --- PSRAM (FQBN: PSRAM=opi). 8048S043C has WROOM-1 N16R8 = 8 MB octal
# at 1.8V. SPEED_80M matches arduino-esp32 default. Keep allocations
# opt-in (USE_MALLOC=n) so internal DRAM is the default for small
# allocations.
CONFIG_SPIRAM=y
CONFIG_SPIRAM_MODE_OCT=y
CONFIG_SPIRAM_TYPE_AUTO=y
CONFIG_SPIRAM_SPEED_80M=y
CONFIG_SPIRAM_USE_MALLOC=n
CONFIG_SPIRAM_USE_CAPS_ALLOC=y

# --- USB console (FQBN: CDCOnBoot=default). 8048S043C uses on-board
# CH340 USB-UART bridge wired to UART0. Serial.print() routes through
# the bridge, not native USB-Serial-JTAG.
CONFIG_ESP_CONSOLE_UART_DEFAULT=y

# --- FATFS Long File Names — without this, SAVE "SDCARD.LONGNAME"
# fails silently because FATFS truncates to 8.3.
CONFIG_FATFS_LFN_HEAP=y

# --- WiFi static pool tuning (aggressive). Profile: a single web
# client at a time and 1-2 BLE peers, so the WiFi pool can run very
# small. WPA2 reconnect still needs internal DRAM for AES contexts —
# previous (6/6/8/8) sizing crashed the BT/WiFi crypto path when
# AsyncWebServer.begin() loaded the lwIP/AsyncTCP buffers on top.
# Cutting to (4/4/4/4) frees ~12 KB internal DRAM for crypto headroom.
CONFIG_ESP_WIFI_STATIC_RX_BUFFER_NUM=4
CONFIG_ESP_WIFI_STATIC_TX_BUFFER_NUM=4
CONFIG_ESP_WIFI_DYNAMIC_RX_BUFFER_NUM=4
CONFIG_ESP_WIFI_DYNAMIC_TX_BUFFER_NUM=4
CONFIG_ESP_WIFI_AMPDU_TX_ENABLED=n
CONFIG_ESP_WIFI_AMPDU_RX_ENABLED=n

# --- lwIP tuning. 4 sockets is enough for 1 HTTP listen + 1 accept +
# 1 DHCP renew + small headroom. OOSEQ and SACK both disabled — saves
# ~2.5 KB of reassembly buffers we never use at LAN speeds where
# packets arrive in order. TCP window/send still 4 KB (LAN-speed
# bursts don't benefit from window scaling).
CONFIG_LWIP_MAX_SOCKETS=4
# TCP window + send buffer back up to 8 KB. We tried 4 KB during the
# initial DRAM diet but it throttled the 8 KB SPA HTML to ~130 B/s:
# server could only have 4 KB unacked, so every response paid an
# RTT-mid-stream. 8 KB lets the SPA stream in one window. Net DRAM
# cost is ~8 KB extra in lwIP, well within budget post-WiFi-trim.
CONFIG_LWIP_TCP_WND_DEFAULT=8192
CONFIG_LWIP_TCP_SND_BUF_DEFAULT=8192
CONFIG_LWIP_TCPIP_TASK_STACK_SIZE=2560
# CONFIG_LWIP_TCP_QUEUE_OOSEQ is not set
# CONFIG_LWIP_TCP_SACK_OUT is not set

# --- NimBLE host stack (used by BLE keyboard). Profile: 1-2 active
# peers (keyboard + occasional gamepad), so MAX_CONNECTIONS=2 stands.
# Bonds dropped 4 -> 2 and CCCDs 8 -> 4 since each ProtoArc L75 only
# needs one slot; freeing the rest gives the controller more crypto
# headroom for simultaneous WiFi WPA2 reconnect events.
CONFIG_BT_ENABLED=y
CONFIG_BT_NIMBLE_ENABLED=y
CONFIG_BT_NIMBLE_MAX_CONNECTIONS=2
CONFIG_BT_NIMBLE_MAX_BONDS=2
CONFIG_BT_NIMBLE_MAX_CCCDS=4

# Move NimBLE host's DYNAMIC allocations to PSRAM. Without this, the
# pairing-time crypto contexts (ECDH key pair, AES contexts, security
# DB entry) land in internal DRAM and trip "E BLE_INIT: Malloc failed"
# during HID service registration AFTER successful authentication. The
# keyboard then reports connected but no HID service is bound and no
# keystrokes arrive. Heap probe data: post-BLE init the largest free
# INTERNAL block is only ~7.5 KB (matches MSYS_2 pool = 24*320=7680
# exactly — that pool fragments the heap), and HID service registration
# needs a single >7.5 KB allocation. CONFIG_BT_ALLOCATION_FROM_SPIRAM_FIRST
# (kept below) only covers the BT *controller* allocations, not NimBLE
# host. _EXTERNAL routes NimBLE through PSRAM where 6.8 MB is free.
# Latency penalty is negligible for the HID host workload.
CONFIG_BT_NIMBLE_MEM_ALLOC_MODE_EXTERNAL=y
# CONFIG_BT_NIMBLE_MEM_ALLOC_MODE_INTERNAL is not set

# Shrink NimBLE static pools for a HID-only profile. Defaults are sized
# for general-purpose BLE (24 ACL slots, 30 evt slots, 64 prep entries,
# 12-entry whitelist). HID keyboards are low-bandwidth and we only ever
# bond 2 peers, so most of that is dead weight burning internal DRAM
# (these pools are statically allocated in BSS, not in PSRAM heap, so
# even with _EXTERNAL above we still want them small).
CONFIG_BT_NIMBLE_TRANSPORT_ACL_FROM_LL_COUNT=8
CONFIG_BT_NIMBLE_TRANSPORT_EVT_COUNT=12
CONFIG_BT_NIMBLE_MSYS_2_BLOCK_COUNT=12
CONFIG_BT_NIMBLE_WHITELIST_SIZE=4
CONFIG_BT_NIMBLE_ATT_MAX_PREP_ENTRIES=4
CONFIG_BT_NIMBLE_GATT_MAX_PROCS=2

# Push BT *controller* allocations into PSRAM too. With BT_NIMBLE_MEM_
# ALLOC_MODE_EXTERNAL above this is somewhat redundant for routine
# allocations but the controller has its own coexistence buffer path
# that this setting governs separately.
CONFIG_BT_ALLOCATION_FROM_SPIRAM_FIRST=y

# Mute NimBLE INFO chatter (BLE_INIT logs every scan/connect cycle).
# CONFIG_BT_NIMBLE_LOG_LEVEL_INFO is not set
CONFIG_BT_NIMBLE_LOG_LEVEL_WARNING=y

# --- CPU + scheduling ---
CONFIG_ESP_DEFAULT_CPU_FREQ_MHZ_240=y
CONFIG_FREERTOS_HZ=1000
CONFIG_ESP_TASK_WDT_CHECK_IDLE_TASK_CPU0=y
CONFIG_ESP_TASK_WDT_CHECK_IDLE_TASK_CPU1=y

# --- Arduino-as-component. With AUTOSTART_ARDUINO=y the Arduino layer
# spins its own task that runs setup() then loop() repeatedly — same
# lifecycle as the arduino-cli build. No hand-written app_main()
# needed. LOOP_STACK matches arduino-cli's default.
CONFIG_AUTOSTART_ARDUINO=y
CONFIG_ARDUINO_RUNNING_CORE=1
CONFIG_ARDUINO_EVENT_RUNNING_CORE=1
CONFIG_ARDUINO_LOOP_STACK_SIZE=16384
```
